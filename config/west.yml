## config/west.yml
```yaml
manifest:
  remotes:
    - name: zmkfirmware
      url-base: https://github.com/zmkfirmware
    - name: alexdunphy
      url-base: https://github.com/alexdunphy
  projects:
    - name: zmk
      remote: alexdunphy
      revision: split-encoder
      import: app/west.yml
  self:
    path: config
```
